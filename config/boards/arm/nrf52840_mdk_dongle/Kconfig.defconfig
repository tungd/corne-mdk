## config/boards/arm/nrf52840_mdk_dongle/Kconfig.defconfig
```kconfig
# nRF52840-MDK board configuration

# Copyright (c) 2021 Adam BZH (bzhthedeveloper@gmail.com)
# SPDX-License-Identifier: Apache-2.0

if BOARD_NRF52840_MDK_DONGLE

config BOARD
  default "nrf52840_mdk_dongle"

if USB

config USB_NRFX
  default y

config USB_DEVICE_STACK
  default y

endif # USB

config BT_CTLR
  default BT

config ZMK_BLE
  default y

config ZMK_USB
  default y


endif # BOARD_NRF52840_MDK_DONGLE
```

## config/boards/shields/corne_mdk/Kconfig.shield
```kconfig
# Copyright (c) 2020 Pete Johanson
# SPDX-License-Identifier: MIT

config SHIELD_CORNE_MDK_LEFT
  def_bool $(shields_list_contains,corne_mdk_left)

config SHIELD_CORNE_MDK_RIGHT
  def_bool $(shields_list_contains,corne_mdk_right)
```
